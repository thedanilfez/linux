## Documentation/devicetree/bindings/sound/qcom,q6mvm.yaml
```yaml
# SPDX-License-Identifier: GPL-2.0 OR BSD-2-Clause
%YAML 1.2
---
$id: http://devicetree.org/schemas/sound/qcom,q6mvm.yaml#
$schema: http://devicetree.org/meta-schemas/core.yaml#

title: Qualcomm Multimode Voice Manager (Q6MVM)

maintainers:
  - Srinivas Kandagatla <srinivas.kandagatla@linaro.org>

description:
  Q6MVM is one of the APR audio services on Q6DSP. It owns the voice session
  graph that connects the modem vocoder stream to one or more vocprocs.

allOf:
  - $ref: /schemas/soc/qcom/qcom,apr-services.yaml#

properties:
  compatible:
    enum:
      - qcom,q6mvm

  dais:
    type: object
    $ref: /schemas/sound/qcom,q6voice-dais.yaml#
    unevaluatedProperties: false
    description: Qualcomm DSP voice frontend DAIs

required:
  - compatible
  - dais

unevaluatedProperties: false

examples:
  - |
    #include <dt-bindings/soc/qcom,apr.h>

    apr {
        #address-cells = <1>;
        #size-cells = <0>;

        service@9 {
            compatible = "qcom,q6mvm";
            reg = <APR_SVC_ADSP_MVM>;
            qcom,protection-domain = "avs/audio", "msm/adsp/audio_pd";

            dais {
                compatible = "qcom,q6voice-dais";
                #sound-dai-cells = <1>;
            };
        };
    };
```

## Documentation/devicetree/bindings/sound/qcom,q6voice-dais.yaml
```yaml
# SPDX-License-Identifier: GPL-2.0 OR BSD-2-Clause
%YAML 1.2
---
$id: http://devicetree.org/schemas/sound/qcom,q6voice-dais.yaml#
$schema: http://devicetree.org/meta-schemas/core.yaml#

title: Qualcomm Q6Voice Digital Audio Interface

maintainers:
  - Srinivas Kandagatla <srinivas.kandagatla@linaro.org>

description:
  The Q6Voice DAI is a control-only frontend that ties an ALSA PCM to the
  QDSP6 Voice Services session (MVM/CVS/CVP). No audio samples cross the
  application processor.

properties:
  compatible:
    enum:
      - qcom,q6voice-dais

  "#sound-dai-cells":
    const: 1

required:
  - compatible
  - "#sound-dai-cells"

additionalProperties: false

examples:
  - |
    dais {
        compatible = "qcom,q6voice-dais";
        #sound-dai-cells = <1>;
    };
```
