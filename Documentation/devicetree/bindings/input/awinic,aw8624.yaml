## Documentation/devicetree/bindings/input/awinic,aw8624.yaml
```yaml
# SPDX-License-Identifier: (GPL-2.0-only OR BSD-2-Clause)
%YAML 1.2
---
$id: http://devicetree.org/schemas/input/awinic,aw8624.yaml#
$schema: http://devicetree.org/meta-schemas/core.yaml#

title: Awinic AW8624 LRA haptic controller

maintainers:
  - Danila Tikhonov <danila@jiaxyga.com>

properties:
  compatible:
    const: awinic,aw8624

  reg:
    maxItems: 1

  interrupts:
    maxItems: 1
    description: Falling edge interrupt from the INTN pin.

  reset-gpios:
    maxItems: 1
    description: Active low reset connected to the RSTN pin.

  awinic,f0-preset:
    $ref: /schemas/types.yaml#/definitions/uint32
    minimum: 1000
    maximum: 3000
    description: Nominal LRA resonance frequency in tenths of a hertz.

  awinic,f0-calibration-percent:
    maximum: 7
    description: Maximum permitted deviation from the nominal resonance, in percent.

  awinic,drive-level:
    $ref: /schemas/types.yaml#/definitions/uint32
    maximum: 127
    description: Continuous drive amplitude in the DRV_LVL register.

  awinic,overdrive-level:
    $ref: /schemas/types.yaml#/definitions/uint32
    maximum: 255
    description: Overdrive amplitude in the DRV_LVL_OV register.

  awinic,drive-time:
    $ref: /schemas/types.yaml#/definitions/uint32
    maximum: 65535
    description: Continuous drive delay and braking time encoded in TD_H and TD_L.

  awinic,zero-cross-threshold:
    $ref: /schemas/types.yaml#/definitions/uint32
    maximum: 65535
    description: Zero crossing threshold encoded in ZC_THRSH_H and ZC_THRSH_L.

  awinic,brake-cycles:
    $ref: /schemas/types.yaml#/definitions/uint32
    maximum: 7
    description: Number of braking cycles after continuous playback.

  awinic,tset:
    $ref: /schemas/types.yaml#/definitions/uint32
    maximum: 255
    description: LRA timing configuration encoded in the TSET register.

  awinic,bemf-upper-threshold:
    $ref: /schemas/types.yaml#/definitions/uint32
    maximum: 65535
    description: Upper back EMF threshold encoded in BEMF_VTHH_H and BEMF_VTHH_L.

  awinic,bemf-lower-threshold:
    $ref: /schemas/types.yaml#/definitions/uint32
    maximum: 65535
    description: Lower back EMF threshold encoded in BEMF_VTHL_H and BEMF_VTHL_L.

  awinic,f0-trace-parameters:
    $ref: /schemas/types.yaml#/definitions/uint32-array
    description: Waveform period counts used for resonance detection.
    items:
      - description: Number of drive periods in the first detection interval.
        maximum: 15
      - description: Number of waiting periods between detection intervals.
        maximum: 15
      - description: Number of detection repetitions.
        minimum: 1
        maximum: 255
      - description: Number of drive periods in subsequent detection intervals.
        maximum: 255

required:
  - compatible
  - reg
  - interrupts
  - reset-gpios
  - awinic,f0-preset
  - awinic,f0-calibration-percent
  - awinic,drive-level
  - awinic,overdrive-level
  - awinic,drive-time
  - awinic,zero-cross-threshold
  - awinic,brake-cycles
  - awinic,tset
  - awinic,bemf-upper-threshold
  - awinic,bemf-lower-threshold
  - awinic,f0-trace-parameters

additionalProperties: false

examples:
  - |
    #include <dt-bindings/gpio/gpio.h>
    #include <dt-bindings/interrupt-controller/irq.h>

    i2c {
        #address-cells = <1>;
        #size-cells = <0>;

        haptics@5a {
            compatible = "awinic,aw8624";
            reg = <0x5a>;
            interrupts-extended = <&gpio 10 IRQ_TYPE_EDGE_FALLING>;
            reset-gpios = <&gpio 4 GPIO_ACTIVE_LOW>;

            awinic,f0-preset = <2050>;
            awinic,f0-calibration-percent = <7>;
            awinic,drive-level = <106>;
            awinic,overdrive-level = <155>;
            awinic,drive-time = <0xf06c>;
            awinic,zero-cross-threshold = <0x08f8>;
            awinic,brake-cycles = <3>;
            awinic,tset = <0x11>;
            awinic,bemf-upper-threshold = <0x0008>;
            awinic,bemf-lower-threshold = <0x03f8>;
            awinic,f0-trace-parameters = <9 5 1 15>;
        };
    };
```

## Documentation/devicetree/bindings/media/i2c/sony,imx471.yaml
```yaml
# SPDX-License-Identifier: (GPL-2.0-only OR BSD-2-Clause)
%YAML 1.2
---
$id: http://devicetree.org/schemas/media/i2c/sony,imx471.yaml#
$schema: http://devicetree.org/meta-schemas/core.yaml#

title: Sony IMX471 Sensor

maintainers:
  - thedanilfez <thedanilfezlol@gmail.com>

description:
  The IMX471 sensor is a 4656x3496 image sensor, commonly found as the front
  camera in smartphones.

allOf:
  - $ref: /schemas/media/video-interface-devices.yaml#

properties:
  compatible:
    const: sony,imx471

  reg:
    maxItems: 1

  clocks:
    maxItems: 1

  vana-supply:
    description: Analog power supply (2.8 V).

  dvdd-supply:
    description: Digital core power supply (1.05 V).

  dovdd-supply:
    description: Interface power supply (1.8 V).

  reset-gpios:
    description: Reset GPIO (active low).
    maxItems: 1

  port:
    $ref: /schemas/graph.yaml#/$defs/port-base
    additionalProperties: false

    properties:
      endpoint:
        $ref: /schemas/media/video-interfaces.yaml
        unevaluatedProperties: false

        properties:
          data-lanes:
            minItems: 4
            maxItems: 4

          link-frequencies:
            items:
              - const: 702933333

        required:
          - data-lanes
          - link-frequencies

    required:
      - endpoint

required:
  - compatible
  - reg
  - clocks
  - vana-supply
  - dvdd-supply
  - dovdd-supply
  - port

unevaluatedProperties: false

examples:
  - |
    #include <dt-bindings/clock/qcom,camcc-sdm845.h>
    #include <dt-bindings/gpio/gpio.h>

    i2c {
        #address-cells = <1>;
        #size-cells = <0>;

        camera@10 {
            compatible = "sony,imx471";
            reg = <0x10>;

            clocks = <&camcc CAM_CC_MCLK2_CLK>;

            assigned-clocks = <&camcc CAM_CC_MCLK2_CLK>;
            assigned-clock-rates = <19200000>;

            reset-gpios = <&tlmm 9 GPIO_ACTIVE_LOW>;

            vana-supply = <&cam_front_ldo>;
            dvdd-supply = <&cam_front_ldo>;
            dovdd-supply = <&cam_vio_ldo>;

            pinctrl-names = "default";
            pinctrl-0 = <&cam_front_default>;

            rotation = <270>;
            orientation = <0>;

            port {
                cam_front_endpoint: endpoint {
                    data-lanes = <0 1 2 3>;
                    link-frequencies = /bits/ 64 <702933333>;
                    remote-endpoint = <&camss_endpoint1>;
                };
            };
        };
    };
```

## Documentation/devicetree/bindings/power/supply/qcom,pm6150-qg.yaml
```yaml
# SPDX-License-Identifier: (GPL-2.0-only OR BSD-2-Clause)
%YAML 1.2
---
$id: http://devicetree.org/schemas/power/supply/qcom,pm6150-qg.yaml#
$schema: http://devicetree.org/meta-schemas/core.yaml#

title: Qualcomm PM6150 QG fuel gauge

maintainers:
  - Danila Tikhonov <danila@jiaxyga.com>

description: |
  The QG peripheral samples battery voltage and signed current into a FIFO.
  Its SDAM peripheral retains the estimated battery state across reboots.
  The monitored battery supplies the open circuit voltage profile and design
  capacity required to initialize the charge estimate.

allOf:
  - $ref: power-supply.yaml#

properties:
  compatible:
    const: qcom,pm6150-qg

  reg:
    maxItems: 1

  interrupts:
    maxItems: 2

  interrupt-names:
    items:
      - const: fifo-done
      - const: good-ocv

  io-channels:
    maxItems: 1

  io-channel-names:
    items:
      - const: batt-therm

  nvmem:
    $ref: /schemas/types.yaml#/definitions/phandle
    description: QG SDAM peripheral

  monitored-battery: true

  power-supplies: true

required:
  - compatible
  - reg
  - interrupts
  - interrupt-names
  - io-channels
  - io-channel-names
  - nvmem
  - monitored-battery
  - power-supplies

additionalProperties: false

examples:
  - |
    #include <dt-bindings/interrupt-controller/irq.h>

    pmic {
      #address-cells = <1>;
      #size-cells = <0>;

      qgauge@4800 {
        compatible = "qcom,pm6150-qg";
        reg = <0x4800>;
        interrupts = <0x0 0x48 0x3 IRQ_TYPE_EDGE_RISING>,
                     <0x0 0x48 0x4 IRQ_TYPE_EDGE_RISING>;
        interrupt-names = "fifo-done", "good-ocv";
        io-channels = <&pm6150_adc 0x4a>;
        io-channel-names = "batt-therm";
        nvmem = <&pm6150_qg_sdam>;
        monitored-battery = <&battery>;
        power-supplies = <&pm6150_charger>;
      };
    };
```

## Documentation/devicetree/bindings/regulator/willsemi,wl2866d.yaml
```yaml
# SPDX-License-Identifier: (GPL-2.0-only OR BSD-2-Clause)
%YAML 1.2
---
$id: http://devicetree.org/schemas/regulator/willsemi,wl2866d.yaml#
$schema: http://devicetree.org/meta-schemas/core.yaml#

title: Will Semiconductor WL2866D 4-Channel Camera PMIC

maintainers:
  - thedanilfez <thedanilfezlol@gmail.com>

description: |
  The WL2866D is an I2C controlled 4-channel LDO PMIC for camera
  applications. It provides two DVDD LDOs (N-MOS pass device, powered from
  VIN1 with VIN2 as bias) and two AVDD LDOs (P-MOS pass device, powered from
  VIN2). Output voltage, enable state and active discharge are programmed
  over I2C.

  The active-high EN pin is a global force-on: asserting it powers every
  output at its default voltage and overrides the I2C enable register, so it
  must be deasserted for software control.

properties:
  compatible:
    const: willsemi,wl2866d

  reg:
    maxItems: 1

  vin1-supply:
    description: Power supply for the DVDD1 and DVDD2 LDOs.

  vin2-supply:
    description: |
      Power supply for the AVDD1 and AVDD2 LDOs, bias supply for the DVDD1
      and DVDD2 LDOs, and supply for the control logic and I2C interface.

  enable-gpios:
    description: |
      Active-high global EN pin. Asserting it forces all four outputs on at
      their default voltages, therefore it is deasserted for I2C control. If
      not present, EN is assumed to be tied low in hardware.
    maxItems: 1

  regulators:
    type: object
    additionalProperties: false
    description: |
      List of regulators provided by this controller, named after their
      hardware counterparts.

    patternProperties:
      "^dvdd[12]$":
        type: object
        $ref: regulator.yaml#
        unevaluatedProperties: false
        description: DVDD LDO (0.6 V - 1.8 V, 6 mV step).

      "^avdd[12]$":
        type: object
        $ref: regulator.yaml#
        unevaluatedProperties: false
        description: AVDD LDO (1.2 V - 4.3 V, 12.5 mV step).

required:
  - compatible
  - reg
  - regulators

additionalProperties: false

examples:
  - |
    #include <dt-bindings/gpio/gpio.h>

    i2c {
        #address-cells = <1>;
        #size-cells = <0>;

        regulator@28 {
            compatible = "willsemi,wl2866d";
            reg = <0x28>;

            vin1-supply = <&vreg_s8c_1p35>;
            vin2-supply = <&vreg_bob>;
            enable-gpios = <&tlmm 30 GPIO_ACTIVE_HIGH>;

            regulators {
                dvdd1: dvdd1 {
                    regulator-name = "wl2866d-dvdd1";
                    regulator-min-microvolt = <1200000>;
                    regulator-max-microvolt = <1200000>;
                    regulator-active-discharge = <1>;
                };

                dvdd2: dvdd2 {
                    regulator-name = "wl2866d-dvdd2";
                    regulator-min-microvolt = <1050000>;
                    regulator-max-microvolt = <1050000>;
                    regulator-active-discharge = <1>;
                };

                avdd1: avdd1 {
                    regulator-name = "wl2866d-avdd1";
                    regulator-min-microvolt = <2800000>;
                    regulator-max-microvolt = <2800000>;
                    regulator-active-discharge = <1>;
                };

                avdd2: avdd2 {
                    regulator-name = "wl2866d-avdd2";
                    regulator-min-microvolt = <2700000>;
                    regulator-max-microvolt = <2700000>;
                    regulator-active-discharge = <1>;
                };
            };
        };
    };
...
```

## Documentation/devicetree/bindings/soc/qcom/qcom,smp2p-sleepstate.yaml
```yaml
# SPDX-License-Identifier: GPL-2.0-only OR BSD-2-Clause
%YAML 1.2
---
$id: http://devicetree.org/schemas/soc/qcom/qcom,smp2p-sleepstate.yaml#
$schema: http://devicetree.org/meta-schemas/core.yaml#

title: Qualcomm SMP2P sleep state notifier

maintainers:
  - Bjorn Andersson <andersson@kernel.org>

description:
  Reports the application processor suspend state to a remote processor
  through an outbound SMP2P entry, and lets the remote processor request a
  system wakeup through an inbound SMP2P entry. The sensors framework on the
  DSP uses it to batch data while the system is suspended.

properties:
  compatible:
    const: qcom,smp2p-sleepstate

  interrupts:
    maxItems: 1
    description: Wakeup request from the remote processor.

  qcom,smem-states:
    $ref: /schemas/types.yaml#/definitions/phandle-array
    maxItems: 1
    description: Outbound SMP2P entry and the bit reporting the awake state.

required:
  - compatible
  - interrupts
  - qcom,smem-states

additionalProperties: false

examples:
  - |
    #include <dt-bindings/interrupt-controller/irq.h>

    smp2p-sleepstate {
        compatible = "qcom,smp2p-sleepstate";
        interrupts-extended = <&smp2p_sleepstate_in 0 IRQ_TYPE_EDGE_RISING>;
        qcom,smem-states = <&smp2p_sleepstate_out 12>;
    };
```

## Documentation/devicetree/bindings/sound/qcom,q6cvp.yaml
```yaml
# SPDX-License-Identifier: GPL-2.0 OR BSD-2-Clause
%YAML 1.2
---
$id: http://devicetree.org/schemas/sound/qcom,q6cvp.yaml#
$schema: http://devicetree.org/meta-schemas/core.yaml#

title: Qualcomm Core Voice Processor (Q6CVP)

maintainers:
  - Srinivas Kandagatla <srinivas.kandagatla@linaro.org>

description:
  Q6CVP implements the voice processor (vocproc) that applies the RX/TX
  topologies and bridges the voice stream to the AFE codec ports.

allOf:
  - $ref: /schemas/soc/qcom/qcom,apr-services.yaml#

properties:
  compatible:
    enum:
      - qcom,q6cvp

required:
  - compatible

unevaluatedProperties: false

examples:
  - |
    #include <dt-bindings/soc/qcom,apr.h>

    apr {
        #address-cells = <1>;
        #size-cells = <0>;

        service@b {
            compatible = "qcom,q6cvp";
            reg = <APR_SVC_ADSP_CVP>;
            qcom,protection-domain = "avs/audio", "msm/adsp/audio_pd";
        };
    };
```

## Documentation/devicetree/bindings/sound/qcom,q6cvs.yaml
```yaml
# SPDX-License-Identifier: GPL-2.0 OR BSD-2-Clause
%YAML 1.2
---
$id: http://devicetree.org/schemas/sound/qcom,q6cvs.yaml#
$schema: http://devicetree.org/meta-schemas/core.yaml#

title: Qualcomm Core Voice Stream (Q6CVS)

maintainers:
  - Srinivas Kandagatla <srinivas.kandagatla@linaro.org>

description:
  Q6CVS is the Q6DSP voice service that implements the vocoder stream. For
  modem-controlled calls the stream is created by the modem firmware; the
  application processor only holds a passive-control handle to it.

allOf:
  - $ref: /schemas/soc/qcom/qcom,apr-services.yaml#

properties:
  compatible:
    enum:
      - qcom,q6cvs

required:
  - compatible

unevaluatedProperties: false

examples:
  - |
    #include <dt-bindings/soc/qcom,apr.h>

    apr {
        #address-cells = <1>;
        #size-cells = <0>;

        service@a {
            compatible = "qcom,q6cvs";
            reg = <APR_SVC_ADSP_CVS>;
            qcom,protection-domain = "avs/audio", "msm/adsp/audio_pd";
        };
    };
```
